## build/conf/local.conf
```bitbake
# --- OLYMPUS: CONFIGURACION MAESTRA DE ENERGIA PARA RPI5 ---

MACHINE = "raspberrypi5"
DISTRO = "poky"

# Formato de imagen comprimido para ahorrar espacio
IMAGE_FSTYPES = "wic.bz2"

# --- OPTIMIZACIONES DE HARDWARE (Ahorro de bateria) ---
# Bajamos la frecuencia de la CPU a 1.5GHz (suficiente para una API)
# Desactivamos LEDs y habilitamos UART para el Arduino Mega
RPI_EXTRA_CONFIG = ' \n \
    arm_freq=1500 \n \
    gpu_freq=500 \n \
    dtparam=pwr_led_trigger=none \n \
    dtparam=act_led_trigger=none \n \
    dtoverlay=disable-bt \n \
    enable_uart=1 \n \
    dtparam=i2c_arm=1 \n '

# Eliminamos funciones que no usaremos para ahorrar ciclos de CPU
DISTRO_FEATURES:append = " wifi"
DISTRO_FEATURES:remove = "x11 wayland vulkan opengl bluetooth"

# Configuracion de compilacion paralela (para tu VM e2-standard-16)
BB_NUMBER_THREADS = "16"
PARALLEL_MAKE = "-j 16"

# Aceptar licencias para el firmware de Broadcom (WiFi)
LICENSE_FLAGS_ACCEPTED = "synaptics-killswitch"

# --- CONFIGURACION DE LA SD (128GB) ---
# Añadimos 4GB de espacio extra inicial para logs y datos
IMAGE_ROOTFS_EXTRA_SPACE = "4194304"
# Factor de seguridad de tamaño (1.5x lo necesario)
IMAGE_OVERHEAD_FACTOR = "1.5"

USER_CLASSES ?= "buildstats"
PATCHRESOLVE = "noop"

# Configuración de Cámara CSI (RPi 5)
VIDEO_CAMERA = "1"
# camera_auto_detect se gestiona en rpi-config_%.bbappend (forzado a 0
# para módulos sin EEPROM como OV5647). No establecerlo aquí evita
# conflictos con el dtoverlay explícito.

# Mapear ov5647.dtbo (desplegado flat por rpi-config_%.bbappend) a
# overlays/ov5647.dtbo en la particion boot, igual que los overlays del kernel.
IMAGE_BOOT_FILES:append = " ov5647.dtbo;overlays/ov5647.dtbo"
```
